## west.yml
```yaml
manifest:
  projects:
    - name: zephyr
      url: https://github.com/HubertYGuan/zephyr
      revision: main
      path: zephyr
      west-commands: scripts/west-commands.yml
      import:
        name-allowlist:
          - cmsis
          - hal_espressif
          - hal_nordic
          - nrfxlib
          - littlefs
          - mbedtls
    - name: zlib
      url: https://github.com/nomkar24/zlib.git
      revision: zephyr
      path: modules/lib/zlib
    - name: pdfio
      url: https://github.com/nomkar24/pdfio.git
      revision: zephyr
      path: modules/lib/pdfio
    - name: libcups
      url: https://github.com/nomkar24/libcups_zephyr.git
      revision: zephyr
      path: modules/lib/libcups
    - name: pappl_zephyr
      url: https://github.com/nomkar24/pappl_zephyr.git
      revision: main
      path: modules/lib/pappl_zephyr
  #    - name: mbedtls
  #      url: https://github.com/HubertYGuan/mbedtls
  #      revision: zephyr
  #      path: modules/lib/mbedtls

  self:
    path: module-app
```
