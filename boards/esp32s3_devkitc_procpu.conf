## boards/esp32s3_devkitc_procpu.conf
```kconfig
CONFIG_WIFI_ESP32=y
CONFIG_ESP32_WIFI_STA_AUTO_DHCPV4=y
CONFIG_WIFI_NM=y
CONFIG_WIFI_NM_MAX_MANAGED_INTERFACES=2

CONFIG_ESP_SPIRAM=y
CONFIG_SPIRAM_MODE_OCT=y

# WiFi Heap
CONFIG_ESP_WIFI_HEAP_SPIRAM=y
CONFIG_ESP32_WIFI_NET_ALLOC_SPIRAM=y
# CONFIG_ESP_SPIRAM_HEAP_SIZE=2097152
CONFIG_ESP_SPIRAM_HEAP_SIZE=4294352

CONFIG_ESP_SPIRAM_MEMTEST=n
CONFIG_SPIRAM_FETCH_INSTRUCTIONS=y
CONFIG_SPIRAM_RODATA=y

CONFIG_CUPS_USE_EXTERNAL_HEAP=y
```
